AUTOSAR XML (schema 00054)
package /Compositions
  composition sw component type CVC_Composition
    12 x component:
      Swc_CanMonitor: type=CVC_Swc_CanMonitor
      Swc_CvcCom: type=CVC_Swc_CvcCom
      Swc_CvcDcm: type=CVC_Swc_CvcDcm
      Swc_Dashboard: type=CVC_Swc_Dashboard
      Swc_EStop: type=CVC_Swc_EStop
      Swc_Heartbeat: type=CVC_Swc_Heartbeat
      Swc_Nvm: type=CVC_Swc_Nvm
      Swc_Pedal: type=CVC_Swc_Pedal
      Swc_Scheduler: type=CVC_Swc_Scheduler
      Swc_SelfTest: type=CVC_Swc_SelfTest
      Swc_VehicleState: type=CVC_Swc_VehicleState
      Swc_Watchdog: type=CVC_Swc_Watchdog
    connect Swc_CvcCom.PP_CVC_SIG_STEERING_FAULT -> Swc_VehicleState.RP_CVC_SIG_STEERING_FAULT
    connect Swc_CvcCom.PP_CVC_SIG_MOTOR_CUTOFF -> Swc_VehicleState.RP_CVC_SIG_MOTOR_CUTOFF
    connect Swc_CvcCom.PP_CVC_SIG_FAULT_MASK -> Swc_Dashboard.RP_CVC_SIG_FAULT_MASK
    connect Swc_CvcCom.PP_CVC_SIG_BATTERY_STATUS -> Swc_VehicleState.RP_CVC_SIG_BATTERY_STATUS
    connect Swc_CvcCom.PP_CVC_SIG_SC_RELAY_KILL -> Swc_VehicleState.RP_CVC_SIG_SC_RELAY_KILL
    connect Swc_CvcCom.PP_CVC_SIG_MOTOR_FAULT_RZC -> Swc_VehicleState.RP_CVC_SIG_MOTOR_FAULT_RZC
    connect Swc_CvcCom.PP_CVC_SIG_BRAKE_FAULT -> Swc_VehicleState.RP_CVC_SIG_BRAKE_FAULT
    connect Swc_EStop.PP_CVC_SIG_ESTOP_ACTIVE -> Swc_CvcCom.RP_CVC_SIG_ESTOP_ACTIVE
    connect Swc_EStop.PP_CVC_SIG_ESTOP_ACTIVE -> Swc_VehicleState.RP_CVC_SIG_ESTOP_ACTIVE
    connect Swc_Heartbeat.PP_CVC_SIG_RZC_COMM_STATUS -> Swc_CvcCom.RP_CVC_SIG_RZC_COMM_STATUS
    connect Swc_Heartbeat.PP_CVC_SIG_RZC_COMM_STATUS -> Swc_VehicleState.RP_CVC_SIG_RZC_COMM_STATUS
    connect Swc_Heartbeat.PP_CVC_SIG_FZC_COMM_STATUS -> Swc_CvcCom.RP_CVC_SIG_FZC_COMM_STATUS
    connect Swc_Heartbeat.PP_CVC_SIG_FZC_COMM_STATUS -> Swc_VehicleState.RP_CVC_SIG_FZC_COMM_STATUS
    connect Swc_Pedal.PP_CVC_SIG_TORQUE_REQUEST -> Swc_CvcCom.RP_CVC_SIG_TORQUE_REQUEST
    connect Swc_Pedal.PP_CVC_SIG_TORQUE_REQUEST -> Swc_VehicleState.RP_CVC_SIG_TORQUE_REQUEST
    connect Swc_Pedal.PP_CVC_SIG_PEDAL_FAULT -> Swc_CvcCom.RP_CVC_SIG_PEDAL_FAULT
    connect Swc_Pedal.PP_CVC_SIG_PEDAL_FAULT -> Swc_CvcDcm.RP_CVC_SIG_PEDAL_FAULT
    connect Swc_Pedal.PP_CVC_SIG_PEDAL_FAULT -> Swc_VehicleState.RP_CVC_SIG_PEDAL_FAULT
    connect Swc_Pedal.PP_CVC_SIG_PEDAL_POSITION -> Swc_CvcDcm.RP_CVC_SIG_PEDAL_POSITION
    connect Swc_Pedal.PP_CVC_SIG_PEDAL_POSITION -> Swc_Dashboard.RP_CVC_SIG_PEDAL_POSITION
    connect Swc_Pedal.PP_CVC_SIG_PEDAL_POSITION -> Swc_VehicleState.RP_CVC_SIG_PEDAL_POSITION
    connect Swc_VehicleState.PP_CVC_SIG_VEHICLE_STATE -> Swc_CvcDcm.RP_CVC_SIG_VEHICLE_STATE
    connect Swc_VehicleState.PP_CVC_SIG_VEHICLE_STATE -> Swc_Dashboard.RP_CVC_SIG_VEHICLE_STATE
    connect Swc_VehicleState.PP_CVC_SIG_VEHICLE_STATE -> Swc_Heartbeat.RP_CVC_SIG_VEHICLE_STATE
    connect Swc_VehicleState.PP_CVC_SIG_VEHICLE_STATE -> Swc_Pedal.RP_CVC_SIG_VEHICLE_STATE
  composition sw component type FZC_Composition
    12 x component:
      Swc_Brake: type=FZC_Swc_Brake
      Swc_Buzzer: type=FZC_Swc_Buzzer
      Swc_FzcCanMonitor: type=FZC_Swc_FzcCanMonitor
      Swc_FzcCom: type=FZC_Swc_FzcCom
      Swc_FzcDcm: type=FZC_Swc_FzcDcm
      Swc_FzcNvm: type=FZC_Swc_FzcNvm
      Swc_FzcSafety: type=FZC_Swc_FzcSafety
      Swc_FzcScheduler: type=FZC_Swc_FzcScheduler
      Swc_FzcSensorFeeder: type=FZC_Swc_FzcSensorFeeder
      Swc_Heartbeat: type=FZC_Swc_Heartbeat
      Swc_Lidar: type=FZC_Swc_Lidar
      Swc_Steering: type=FZC_Swc_Steering
    connect Swc_Brake.PP_FZC_SIG_BRAKE_POS -> Swc_FzcCom.RP_FZC_SIG_BRAKE_POS
    connect Swc_Brake.PP_FZC_SIG_BRAKE_POS -> Swc_FzcDcm.RP_FZC_SIG_BRAKE_POS
    connect Swc_FzcSafety.PP_FZC_SIG_MOTOR_CUTOFF -> Swc_FzcCom.RP_FZC_SIG_MOTOR_CUTOFF
    connect Swc_Brake.PP_FZC_SIG_BRAKE_FAULT -> Swc_FzcCom.RP_FZC_SIG_BRAKE_FAULT
    connect Swc_Brake.PP_FZC_SIG_BRAKE_FAULT -> Swc_FzcSafety.RP_FZC_SIG_BRAKE_FAULT
    connect Swc_FzcCom.PP_FZC_SIG_STEER_CMD -> Swc_Steering.RP_FZC_SIG_STEER_CMD
    connect Swc_FzcCom.PP_FZC_SIG_BRAKE_CMD -> Swc_Brake.RP_FZC_SIG_BRAKE_CMD
    connect Swc_FzcCom.PP_FZC_SIG_VEHICLE_STATE -> Swc_Buzzer.RP_FZC_SIG_VEHICLE_STATE
    connect Swc_FzcCom.PP_FZC_SIG_VEHICLE_STATE -> Swc_FzcSafety.RP_FZC_SIG_VEHICLE_STATE
    connect Swc_FzcCom.PP_FZC_SIG_VEHICLE_STATE -> Swc_Heartbeat.RP_FZC_SIG_VEHICLE_STATE
    connect Swc_FzcCom.PP_FZC_SIG_ESTOP_ACTIVE -> Swc_Brake.RP_FZC_SIG_ESTOP_ACTIVE
    connect Swc_FzcSafety.PP_FZC_SIG_FAULT_MASK -> Swc_Heartbeat.RP_FZC_SIG_FAULT_MASK
    connect Swc_Lidar.PP_FZC_SIG_LIDAR_FAULT -> Swc_FzcSafety.RP_FZC_SIG_LIDAR_FAULT
    connect Swc_Lidar.PP_FZC_SIG_LIDAR_DIST -> Swc_FzcCom.RP_FZC_SIG_LIDAR_DIST
    connect Swc_Lidar.PP_FZC_SIG_LIDAR_DIST -> Swc_FzcDcm.RP_FZC_SIG_LIDAR_DIST
    connect Swc_Lidar.PP_FZC_SIG_LIDAR_ZONE -> Swc_Buzzer.RP_FZC_SIG_LIDAR_ZONE
    connect Swc_Lidar.PP_FZC_SIG_LIDAR_ZONE -> Swc_FzcCom.RP_FZC_SIG_LIDAR_ZONE
    connect Swc_Lidar.PP_FZC_SIG_LIDAR_ZONE -> Swc_FzcDcm.RP_FZC_SIG_LIDAR_ZONE
    connect Swc_Lidar.PP_FZC_SIG_LIDAR_SIGNAL -> Swc_FzcDcm.RP_FZC_SIG_LIDAR_SIGNAL
    connect Swc_Steering.PP_FZC_SIG_STEER_ANGLE -> Swc_FzcCom.RP_FZC_SIG_STEER_ANGLE
    connect Swc_Steering.PP_FZC_SIG_STEER_ANGLE -> Swc_FzcDcm.RP_FZC_SIG_STEER_ANGLE
    connect Swc_Steering.PP_FZC_SIG_STEER_FAULT -> Swc_FzcCom.RP_FZC_SIG_STEER_FAULT
    connect Swc_Steering.PP_FZC_SIG_STEER_FAULT -> Swc_FzcSafety.RP_FZC_SIG_STEER_FAULT
  composition sw component type RZC_Composition
    13 x component:
      Swc_Battery: type=RZC_Swc_Battery
      Swc_CurrentMonitor: type=RZC_Swc_CurrentMonitor
      Swc_Encoder: type=RZC_Swc_Encoder
      Swc_Heartbeat: type=RZC_Swc_Heartbeat
      Swc_Motor: type=RZC_Swc_Motor
      Swc_RzcCom: type=RZC_Swc_RzcCom
      Swc_RzcDcm: type=RZC_Swc_RzcDcm
      Swc_RzcNvm: type=RZC_Swc_RzcNvm
      Swc_RzcSafety: type=RZC_Swc_RzcSafety
      Swc_RzcScheduler: type=RZC_Swc_RzcScheduler
      Swc_RzcSelfTest: type=RZC_Swc_RzcSelfTest
      Swc_RzcSensorFeeder: type=RZC_Swc_RzcSensorFeeder
      Swc_TempMonitor: type=RZC_Swc_TempMonitor
    connect Swc_Battery.PP_BatSt_BatteryVoltage_mV -> Swc_RzcCom.RP_BatSt_BatteryVoltage_mV
    connect Swc_Battery.PP_BatSt_BatteryVoltage_mV -> Swc_RzcDcm.RP_BatSt_BatteryVoltage_mV
    connect Swc_Battery.PP_BatSt_Status -> Swc_RzcCom.RP_BatSt_Status
    connect Swc_Battery.PP_BatSt_Status -> Swc_RzcSafety.RP_BatSt_Status
    connect Swc_Battery.PP_BatSt_Status -> Swc_RzcCom.RP_BatSt_Status
    connect Swc_CurrentMonitor.PP_MtrCur_Current_mA -> Swc_RzcCom.RP_MtrCur_Current_mA
    connect Swc_CurrentMonitor.PP_MtrCur_Current_mA -> Swc_RzcDcm.RP_MtrCur_Current_mA
    connect Swc_CurrentMonitor.PP_MtrCur_OvercurrentFlag -> Swc_Motor.RP_MtrCur_OvercurrentFlag
    connect Swc_CurrentMonitor.PP_MtrCur_OvercurrentFlag -> Swc_RzcCom.RP_MtrCur_OvercurrentFlag
    connect Swc_CurrentMonitor.PP_MtrCur_OvercurrentFlag -> Swc_RzcSafety.RP_MtrCur_OvercurrentFlag
    connect Swc_Encoder.PP_RZC_SIG_ENCODER_SPEED -> Swc_RzcCom.RP_RZC_SIG_ENCODER_SPEED
    connect Swc_Encoder.PP_RZC_SIG_ENCODER_SPEED -> Swc_RzcDcm.RP_RZC_SIG_ENCODER_SPEED
    connect Swc_Encoder.PP_RZC_SIG_ENCODER_STALL -> Swc_RzcSafety.RP_RZC_SIG_ENCODER_STALL
    connect Swc_Encoder.PP_RZC_SIG_ENCODER_DIR -> Swc_RzcSafety.RP_RZC_SIG_ENCODER_DIR
    connect Swc_Motor.PP_MtrSt_MotorFaultStatus -> Swc_RzcCom.RP_MtrSt_MotorFaultStatus
    connect Swc_Motor.PP_MtrSt_MotorEnable -> Swc_RzcCom.RP_MtrSt_MotorEnable
    connect Swc_Motor.PP_MtrCur_TorqueEcho -> Swc_Encoder.RP_MtrCur_TorqueEcho
    connect Swc_Motor.PP_MtrCur_TorqueEcho -> Swc_RzcCom.RP_MtrCur_TorqueEcho
    connect Swc_Motor.PP_MtrCur_TorqueEcho -> Swc_RzcDcm.RP_MtrCur_TorqueEcho
    connect Swc_Motor.PP_MtrSt_MotorDirection -> Swc_Encoder.RP_MtrSt_MotorDirection
    connect Swc_Motor.PP_MtrSt_MotorDirection -> Swc_RzcCom.RP_MtrSt_MotorDirection
    connect Swc_RzcCom.PP_TrqRq_Torque_pct -> Swc_Motor.RP_TrqRq_Torque_pct
    connect Swc_RzcCom.PP_EStBc_EStop_Active -> Swc_Motor.RP_EStBc_EStop_Active
    connect Swc_RzcCom.PP_EStBc_EStop_Active -> Swc_RzcSafety.RP_EStBc_EStop_Active
    connect Swc_RzcSafety.PP_VehSt_FaultMask -> Swc_Heartbeat.RP_VehSt_FaultMask
    connect Swc_TempMonitor.PP_MtrTmp_DeratingPercent -> Swc_Motor.RP_MtrTmp_DeratingPercent
    connect Swc_TempMonitor.PP_MtrTmp_DeratingPercent -> Swc_RzcCom.RP_MtrTmp_DeratingPercent
    connect Swc_TempMonitor.PP_MtrTmp_DeratingPercent -> Swc_RzcDcm.RP_MtrTmp_DeratingPercent
    connect Swc_TempMonitor.PP_RZC_SIG_TEMP_FAULT -> Swc_Motor.RP_RZC_SIG_TEMP_FAULT
    connect Swc_TempMonitor.PP_RZC_SIG_TEMP_FAULT -> Swc_RzcSafety.RP_RZC_SIG_TEMP_FAULT
    connect Swc_TempMonitor.PP_MtrTmp_WindingTemp1_C -> Swc_RzcCom.RP_MtrTmp_WindingTemp1_C
    connect Swc_TempMonitor.PP_MtrTmp_WindingTemp1_C -> Swc_RzcDcm.RP_MtrTmp_WindingTemp1_C
  composition sw component type BCM_Composition
    5 x component:
      Swc_BcmCan: type=BCM_Swc_BcmCan
      Swc_BcmMain: type=BCM_Swc_BcmMain
      Swc_DoorLock: type=BCM_Swc_DoorLock
      Swc_Indicators: type=BCM_Swc_Indicators
      Swc_Lights: type=BCM_Swc_Lights
    connect Swc_DoorLock.PP_DlkSt_FrontLeftLock -> Swc_BcmCan.RP_DlkSt_FrontLeftLock
    connect Swc_Indicators.PP_IndSt_RightOn -> Swc_BcmCan.RP_IndSt_RightOn
    connect Swc_Indicators.PP_IndSt_HazardActive -> Swc_BcmCan.RP_IndSt_HazardActive
    connect Swc_Indicators.PP_IndSt_LeftOn -> Swc_BcmCan.RP_IndSt_LeftOn
    connect Swc_Lights.PP_LtSt_HeadlightOn -> Swc_BcmCan.RP_LtSt_HeadlightOn
    connect Swc_Lights.PP_LtSt_TailLightOn -> Swc_BcmCan.RP_LtSt_TailLightOn
    connect Swc_BcmCan.PP_VehSt_Mode -> Swc_DoorLock.RP_VehSt_Mode
    connect Swc_BcmCan.PP_VehSt_Mode -> Swc_Lights.RP_VehSt_Mode
    connect Swc_BcmCan.PP_BdyCmd_HeadlightCmd -> Swc_Lights.RP_BdyCmd_HeadlightCmd
    connect Swc_BcmCan.PP_BCM_SIG_ESTOP_BROADCAST_ESTOP_ACTIVE -> Swc_Indicators.RP_BCM_SIG_ESTOP_BROADCAST_ESTOP_ACTIVE
  composition sw component type ICU_Composition
    component Swc_Dashboard: type=ICU_Swc_Dashboard
    component Swc_DtcDisplay: type=ICU_Swc_DtcDisplay
  composition sw component type TCU_Composition
    4 x component:
      Swc_DataAggregator: type=TCU_Swc_DataAggregator
      Swc_DtcStore: type=TCU_Swc_DtcStore
      Swc_Obd2Pids: type=TCU_Swc_Obd2Pids
      Swc_UdsServer: type=TCU_Swc_UdsServer
package /SystemMapping
  system TaktflowSystem
    system mapping EcuMapping
      sw-mappings:
        48 x swc to ecu mapping:
          Swc_CanMonitor_to_CVC: component=Swc_CanMonitor, ecu-instance=CVC
          Swc_CvcCom_to_CVC: component=Swc_CvcCom, ecu-instance=CVC
          Swc_CvcDcm_to_CVC: component=Swc_CvcDcm, ecu-instance=CVC
          Swc_Dashboard_to_CVC: component=Swc_Dashboard, ecu-instance=CVC
          Swc_EStop_to_CVC: component=Swc_EStop, ecu-instance=CVC
          Swc_Heartbeat_to_CVC: component=Swc_Heartbeat, ecu-instance=CVC
          Swc_Nvm_to_CVC: component=Swc_Nvm, ecu-instance=CVC
          Swc_Pedal_to_CVC: component=Swc_Pedal, ecu-instance=CVC
          Swc_Scheduler_to_CVC: component=Swc_Scheduler, ecu-instance=CVC
          Swc_SelfTest_to_CVC: component=Swc_SelfTest, ecu-instance=CVC
          Swc_VehicleState_to_CVC: component=Swc_VehicleState, ecu-instance=CVC
          Swc_Watchdog_to_CVC: component=Swc_Watchdog, ecu-instance=CVC
          Swc_Brake_to_FZC: component=Swc_Brake, ecu-instance=FZC
          Swc_Buzzer_to_FZC: component=Swc_Buzzer, ecu-instance=FZC
          Swc_FzcCanMonitor_to_FZC: component=Swc_FzcCanMonitor, ecu-instance=FZC
          Swc_FzcCom_to_FZC: component=Swc_FzcCom, ecu-instance=FZC
          Swc_FzcDcm_to_FZC: component=Swc_FzcDcm, ecu-instance=FZC
          Swc_FzcNvm_to_FZC: component=Swc_FzcNvm, ecu-instance=FZC
          Swc_FzcSafety_to_FZC: component=Swc_FzcSafety, ecu-instance=FZC
          Swc_FzcScheduler_to_FZC: component=Swc_FzcScheduler, ecu-instance=FZC
          Swc_FzcSensorFeeder_to_FZC: component=Swc_FzcSensorFeeder, ecu-instance=FZC
          Swc_Heartbeat_to_FZC: component=Swc_Heartbeat, ecu-instance=FZC
          Swc_Lidar_to_FZC: component=Swc_Lidar, ecu-instance=FZC
          Swc_Steering_to_FZC: component=Swc_Steering, ecu-instance=FZC
          Swc_Battery_to_RZC: component=Swc_Battery, ecu-instance=RZC
          Swc_CurrentMonitor_to_RZC: component=Swc_CurrentMonitor, ecu-instance=RZC
          Swc_Encoder_to_RZC: component=Swc_Encoder, ecu-instance=RZC
          Swc_Heartbeat_to_RZC: component=Swc_Heartbeat, ecu-instance=RZC
          Swc_Motor_to_RZC: component=Swc_Motor, ecu-instance=RZC
          Swc_RzcCom_to_RZC: component=Swc_RzcCom, ecu-instance=RZC
          Swc_RzcDcm_to_RZC: component=Swc_RzcDcm, ecu-instance=RZC
          Swc_RzcNvm_to_RZC: component=Swc_RzcNvm, ecu-instance=RZC
          Swc_RzcSafety_to_RZC: component=Swc_RzcSafety, ecu-instance=RZC
          Swc_RzcScheduler_to_RZC: component=Swc_RzcScheduler, ecu-instance=RZC
          Swc_RzcSelfTest_to_RZC: component=Swc_RzcSelfTest, ecu-instance=RZC
          Swc_RzcSensorFeeder_to_RZC: component=Swc_RzcSensorFeeder, ecu-instance=RZC
          Swc_TempMonitor_to_RZC: component=Swc_TempMonitor, ecu-instance=RZC
          Swc_BcmCan_to_BCM: component=Swc_BcmCan, ecu-instance=BCM
          Swc_BcmMain_to_BCM: component=Swc_BcmMain, ecu-instance=BCM
          Swc_DoorLock_to_BCM: component=Swc_DoorLock, ecu-instance=BCM
          Swc_Indicators_to_BCM: component=Swc_Indicators, ecu-instance=BCM
          Swc_Lights_to_BCM: component=Swc_Lights, ecu-instance=BCM
          Swc_Dashboard_to_ICU: component=Swc_Dashboard, ecu-instance=ICU
          Swc_DtcDisplay_to_ICU: component=Swc_DtcDisplay, ecu-instance=ICU
          Swc_DataAggregator_to_TCU: component=Swc_DataAggregator, ecu-instance=TCU
          Swc_DtcStore_to_TCU: component=Swc_DtcStore, ecu-instance=TCU
          Swc_Obd2Pids_to_TCU: component=Swc_Obd2Pids, ecu-instance=TCU
          Swc_UdsServer_to_TCU: component=Swc_UdsServer, ecu-instance=TCU
