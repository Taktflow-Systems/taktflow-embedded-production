VERSION "1.0.0"

NS_ :

BS_:

BU_: Tester

BO_ 2015 UDS_Func_Request: 8 Tester
 SG_ UdsFnRq_Data : 0|64@1+ (1,0) [0|0] "" CVC,FZC,RZC,TCU,BCM,ICU

BO_ 2016 UDS_Phys_Req_CVC: 8 Tester
 SG_ UdsRqCvc_Data : 0|64@1+ (1,0) [0|0] "" CVC

BO_ 2017 UDS_Phys_Req_FZC: 8 Tester
 SG_ UdsRqFzc_Data : 0|64@1+ (1,0) [0|0] "" FZC

BO_ 2018 UDS_Phys_Req_RZC: 8 Tester
 SG_ UdsRqRzc_Data : 0|64@1+ (1,0) [0|0] "" RZC

BO_ 2019 UDS_Phys_Req_TCU: 8 Tester
 SG_ UdsRqTcu_Data : 0|64@1+ (1,0) [0|0] "" TCU

BO_ 2024 UDS_Resp_CVC: 8 CVC
 SG_ UdsRsCvc_Data : 0|64@1+ (1,0) [0|0] "" Tester

BO_ 2025 UDS_Resp_FZC: 8 FZC
 SG_ UdsRsFzc_Data : 0|64@1+ (1,0) [0|0] "" Tester

BO_ 2026 UDS_Resp_RZC: 8 RZC
 SG_ UdsRsRzc_Data : 0|64@1+ (1,0) [0|0] "" Tester

BO_ 1604 UDS_Resp_TCU: 8 TCU
 SG_ UdsRsTcu_Data : 0|64@1+ (1,0) [0|0] "" Tester

CM_ BU_ Tester "External diagnostic tester. Not deployed to vehicle.";
CM_ BO_ 2015 "UDS functional request. ISO 14229. Broadcast to all ECUs.";
CM_ BO_ 2016 "UDS physical request to CVC. ISO 14229.";
CM_ BO_ 2017 "UDS physical request to FZC. ISO 14229.";
CM_ BO_ 2018 "UDS physical request to RZC. ISO 14229.";
CM_ BO_ 2019 "UDS physical request to TCU. ISO 14229.";
CM_ BO_ 2024 "UDS response from CVC. ISO 14229.";
CM_ BO_ 2025 "UDS response from FZC. ISO 14229.";
CM_ BO_ 2026 "UDS response from RZC. ISO 14229.";
CM_ BO_ 1604 "UDS response from TCU. ISO 14229.";
