VERSION ""

NS_ :

BS_:

BU_: ECU_A ECU_B

BO_ 256 DefaultMessage: 8 ECU_A
 SG_ Speed : 0|16@1+ (1,0) [0|65535] "" ECU_B
